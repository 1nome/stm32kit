/**
  ******************************************************************************
  * @file     example-rtosdonut.c
  * @author   Adam Wiszczor, a1k0n
  * @version  1.0
  * @date     18-April-2024 [v1.2]
  * @brief    Vykresluje donut pres UART, treba nastavit vyssi frekvenci jadra i uartu pro spravny efekt
	*						RTOS verze s dvema buffery, prirozene se stridaji
  *
  * !!! PROZATIM FUNKCNI JEN PRO F407 !!!
  *
  ******************************************************************************
  * @attention
  *
  * Otestovano na: F407
  *
  * Netestovano: F401, F411, G071, L152
  *
  ******************************************************************************
*/

#include "stm32_kit.h"
#include "stm32_kit/uart.h"
#include "stm32_kit/overclock.h"
#include <string.h>
#include <stdio.h>

OS_TID rendertask, printtask;

int k;
float z[1760];
char a[1760], b[1760];
float sini,
      cosj,
      sinA,
      sinj,
      cosA,
      cosj2,
      cosi,
      cosB,
      sinB,
      t, mess;
int x, y, o, N, count = 0;
unsigned int i, j, A=0, B=0;
char counter[10];

float lut[628] = {0,0.00999983,0.0199987,0.0299955,0.0399893,0.0499792,0.059964,0.0699428,0.0799147,0.0898785,0.0998334,0.109778,0.119712,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-0.0131849,
};

float fastsin(unsigned int x)
{
  return lut[x%628];
}

float fastcos(unsigned int x){
	return fastsin(x + 157);
}

#define QualityI 1 // cim vetsi tim mensi kvalita
#define QualityJ 1
#define SpeedA 40
#define SpeedB 20

char aready = 0, bready = 0;

__task void printer(){
	char sw;
	for(;;){
		if(aready || bready){
			sw = aready ? 1 : 0;
			snprintf(counter, 10, "%c%7d\n", sw ? 'a' : 'b' ,count++);
			UART_write(counter, 9);
			UART_write("\x1b[d",3);
				for(k=0; 1761>k; k++){
					UART_putc(k%80?(sw ? a : b)[k]:'\r');
				if(!(k%80)){
					UART_putc('\n');
				}
			}
			*(sw ? &aready : &bready) = 0;
		}
		else{
			os_tsk_pass();
		}
	}
}


__task void renderer(){
	char sw;
    for(; ; ) {
			if(!aready || !bready){
				sw = aready ? 0 : 1;
        memset(sw ? a : b,32,1760);
        memset(z,0,7040);
        for(j=0; 628>j; j+=QualityJ) {
            for(i=0; 628 >i; i+=QualityI) {
                sini=fastsin(i);
                cosj=fastcos(j);
                sinA=fastsin(A);
                sinj=fastsin(j);
                cosA=fastcos(A);
                cosj2=cosj+2;
                mess=1/(sini*cosj2*sinA+sinj*cosA+5);
                cosi=fastcos(i);
                cosB=fastcos(B);
                sinB=fastsin(B);
                t=sini*cosj2*cosA-sinj* sinA;
                x=40+30*mess*(cosi*cosj2*cosB-t*sinB);
                y= 12+15*mess*(cosi*cosj2*sinB +t*cosB);
                o=x+80*y;
                N=8*((sinj*sinA-sini*cosj*cosA)*cosB-sini*cosj*sinA-sinj*cosA-cosi *cosj*sinB);
                if(22>y&&y>0&&x>0&&80>x&&mess>z[o]){
                    z[o]=mess;
									(sw ? a : b)[o]=".,-~:;=!*#$@"[N>0?N:0];
                }
            }
        }
        A+=SpeedA;
        B+=SpeedB;
				*(sw ? &aready : &bready) = 1;
			}
			else{
				os_tsk_pass();
			}
    }
}

__task void setup() {
	clock168Mhz();
	UART_setup();
	
	UART_write("\x1b[2J",4);
	
	rendertask = os_tsk_create(renderer, 0);
	printtask = os_tsk_create(printer, 0);
	os_tsk_delete_self();
}

int main () {
	os_sys_init(setup);
}
